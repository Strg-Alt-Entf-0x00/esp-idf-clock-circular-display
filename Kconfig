## Kconfig
```kconfig
menu "Circular 24h Funkuhr Component"

    menu "Hardware Display & Pinout Configuration"

        config CIRCULAR_CLOCK_PIN_MOSI
            int "SPI MOSI GPIO"
            default 28 if IDF_TARGET_ESP32P4
            default 11 if IDF_TARGET_ESP32S3
            default 23 if IDF_TARGET_ESP32
            default 28
            help
                GPIO number connected to GC9A01 display MOSI (SDA).

        config CIRCULAR_CLOCK_PIN_SCLK
            int "SPI SCLK GPIO"
            default 27 if IDF_TARGET_ESP32P4
            default 12 if IDF_TARGET_ESP32S3
            default 18 if IDF_TARGET_ESP32
            default 27
            help
                GPIO number connected to GC9A01 display SCLK.

        config CIRCULAR_CLOCK_PIN_CS
            int "SPI Chip Select (CS) GPIO"
            default 24 if IDF_TARGET_ESP32P4
            default 10 if IDF_TARGET_ESP32S3
            default 5 if IDF_TARGET_ESP32
            default 24
            help
                GPIO number connected to GC9A01 display CS.

        config CIRCULAR_CLOCK_PIN_DC
            int "Data / Command (DC) GPIO"
            default 25 if IDF_TARGET_ESP32P4
            default 9 if IDF_TARGET_ESP32S3
            default 2 if IDF_TARGET_ESP32
            default 25
            help
                GPIO number connected to GC9A01 display DC.

        config CIRCULAR_CLOCK_PIN_RST
            int "Reset (RST) GPIO"
            default 26 if IDF_TARGET_ESP32P4
            default 8 if IDF_TARGET_ESP32S3
            default 4 if IDF_TARGET_ESP32
            default 26
            help
                GPIO number connected to GC9A01 display RST (-1 if tied to EN/VCC).

        config CIRCULAR_CLOCK_PIN_BKL
            int "Backlight (BKL) GPIO"
            default -1
            help
                GPIO number for PWM backlight control (-1 if tied to VCC).

        config CIRCULAR_CLOCK_SPI_CLOCK_HZ
            int "SPI Clock Speed (Hz)"
            default 40000000
            help
                SPI bus clock speed in Hz (typically 40000000 for 40 MHz).

    endmenu

endmenu
```

## examples/clock_demo/main/Kconfig.projbuild
```kconfig
menu "24h Circular Funkuhr Configuration"

    config CLOCK_WIFI_ENABLE
        bool "Enable WiFi Internet Time Sync (NTP)"
        default y
        help
            Enables WiFi connection and SNTP synchronization with atomic time servers.

    config CLOCK_WIFI_SSID
        string "WiFi SSID"
        depends on CLOCK_WIFI_ENABLE
        default "YOUR_WIFI_SSID"
        help
            SSID of the wireless network.

    config CLOCK_WIFI_PASSWORD
        string "WiFi Password"
        depends on CLOCK_WIFI_ENABLE
        default "YOUR_WIFI_PASSWORD"
        help
            WPA2 pre-shared key for the wireless network.

    config CLOCK_TIMEZONE
        string "POSIX Timezone String"
        default "CET-1CEST,M3.5.0,M10.5.0/3"
        help
            POSIX timezone format string. Default is Central European Time (CET/CEST)
            with automatic daylight saving transitions.

    choice CLOCK_LANGUAGE
        prompt "Date Display Language"
        default CLOCK_LANG_CHOICE_DE
        help
            Select default language for weekday and month abbreviations.

        config CLOCK_LANG_CHOICE_DE
            bool "German (z.B. Fr, 16. Okt)"

        config CLOCK_LANG_CHOICE_EN
            bool "English (e.g. Fri, 16 Oct)"
    endchoice

    choice CLOCK_DATE_FORMAT_CHOICE
        prompt "Date Display Format"
        default CLOCK_DATE_FORMAT_ABBREV
        help
            Select format for center date readout.

        config CLOCK_DATE_FORMAT_NUMERIC
            bool "Numeric (z.B. Fr 16.10)"

        config CLOCK_DATE_FORMAT_ABBREV
            bool "Abbreviated Month (z.B. Fr, 16. Okt)"

        config CLOCK_DATE_FORMAT_FULL_WEEKDAY
            bool "Full Weekday (z.B. Freitag, 16. Okt)"
    endchoice

    choice CLOCK_BADGE_MODE_CHOICE
        prompt "Top Badge Mode"
        default CLOCK_BADGE_CHOICE_SMART_AUTO
        help
            Display behavior of the circular badge at CY-36.

        config CLOCK_BADGE_CHOICE_SMART_AUTO
            bool "Smart Auto (Antenna during Search/Sync, then clean '24')"

        config CLOCK_BADGE_CHOICE_ALWAYS_ANTENNA
            bool "Always Antenna (Vector antenna ▲))) always visible)"

        config CLOCK_BADGE_CHOICE_ALWAYS_MODE
            bool "Always Mode ('24' or AM/PM always visible)"
    endchoice

endmenu
```

## examples/clock_demo/sdkconfig.defaults
```kconfig
# ============================================================================
# ESP32-P4 Target Configuration
# ============================================================================
CONFIG_IDF_TARGET="esp32p4"
CONFIG_ESP32P4_SELECTS_REV_LESS_V3=y

# ============================================================================
# Flash Configuration (32 MB QIO Mode)
# ============================================================================
CONFIG_ESPTOOLPY_FLASHMODE_QIO=y
CONFIG_ESPTOOLPY_FLASHSIZE_32MB=y

# ============================================================================
# PSRAM Configuration (for display sprite buffer)
# ============================================================================
CONFIG_SPIRAM=y
CONFIG_SPIRAM_USE_MALLOC=y

# ============================================================================
# Compiler Optimization
# ============================================================================
CONFIG_COMPILER_OPTIMIZATION_PERF=y
CONFIG_COMPILER_CXX_EXCEPTIONS=y

# ============================================================================
# FreeRTOS Configuration
# ============================================================================
CONFIG_FREERTOS_HZ=1000
```
